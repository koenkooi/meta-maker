## conf/layer.conf
```bitbake
# We might have a conf and classes directory, append to BBPATH
BBPATH .= ":${LAYERDIR}"

# We have recipes directories, add to BBFILES
BBFILES += "${LAYERDIR}/recipes*/*/*.bb ${LAYERDIR}/recipes*/*/*.bbappend"

BBFILE_COLLECTIONS += "meta-maker"
BBFILE_PATTERN_meta-maker := "^${LAYERDIR}/"
BBFILE_PRIORITY_meta-maker = "7"

LAYERSERIES_COMPAT_meta-maker = "zeus"

PREFERRED_VERSION_python-werkzeug = "0.15.1"
PREFERRED_VERSION_python-websocket-client = "0.56.0"

# This should only be incremented on significant changes that will
# # cause compatibility issues with other layers
LAYERVERSION_meta-maker = "1"

LAYERDEPENDS_meta-maker = "core openembedded-layer meta-python perl-layer"
```
